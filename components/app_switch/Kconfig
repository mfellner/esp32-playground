## components/app_switch/Kconfig
```kconfig
menu "App switch (platform launcher client)"

config APP_SWITCH_BOOT_GPIO
    int "BOOT button GPIO (active low, polled after startup only)"
    default 9
    range -1 30

config APP_SWITCH_BOOT_HOLD_MS
    int "BOOT hold time that opens the launcher (ms)"
    default 1000
    range 300 5000

config APP_SWITCH_KEY_GPIO
    int "KEY button GPIO (active low); -1 disables"
    default 10
    range -1 30
    help
        Waveshare ESP32-C6-Touch-AMOLED-2.16 schematic: Key3 "KEY" on GPIO10 with a 10K pull-up.
        Must not be a strapping pin (GPIO4/5/8/9/15 on the ESP32-C6).

config APP_SWITCH_KEY_MAX_PRESS_MS
    int "Longest KEY press counted as a short press (ms)"
    default 800

endmenu
```

## firmware/launcher/main/Kconfig.projbuild
```kconfig
menu "Launcher validation"
config LAUNCHER_TEST_COMMANDS
    bool "Enable USB validation commands"
    default n
    help
        Validation builds only: TEST_BOOT <label> switches apps over USB. Never enable in releases.
endmenu
```

## firmware/launcher/sdkconfig.defaults
```kconfig
CONFIG_PARTITION_TABLE_CUSTOM_FILENAME="../../components/app_switch/layout/partitions.csv"
CONFIG_ESP_CONSOLE_USB_SERIAL_JTAG=y
CONFIG_ESP_CONSOLE_SECONDARY_NONE=y
CONFIG_COMPILER_OPTIMIZATION_PERF=y
CONFIG_FREERTOS_HZ=1000
CONFIG_ESP_MAIN_TASK_STACK_SIZE=6144
CONFIG_LV_COLOR_DEPTH_16=y
CONFIG_LV_USE_BUILTIN_MALLOC=y
CONFIG_LV_MEM_SIZE_KILOBYTES=64
CONFIG_LV_DEF_REFR_PERIOD=33
CONFIG_LV_DRAW_SW_DRAW_UNIT_CNT=1
CONFIG_LV_FONT_MONTSERRAT_14=n
CONFIG_LV_FONT_MONTSERRAT_16=y
CONFIG_LV_FONT_MONTSERRAT_20=y
CONFIG_LV_FONT_MONTSERRAT_32=y
CONFIG_LV_USE_DEMO_WIDGETS=n
CONFIG_LV_USE_DEMO_BENCHMARK=n
CONFIG_LV_USE_DEMO_STRESS=n
CONFIG_LV_USE_DEMO_MUSIC=n
CONFIG_LV_BUILD_EXAMPLES=n
CONFIG_APP_REPRODUCIBLE_BUILD=y
```

## tests/firmware/crash_app/sdkconfig.defaults
```kconfig
CONFIG_PARTITION_TABLE_CUSTOM_FILENAME="../../../components/app_switch/layout/partitions.csv"
CONFIG_ESP_CONSOLE_USB_SERIAL_JTAG=y
```
